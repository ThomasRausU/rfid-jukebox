## build/conf/local.conf
```bitbake
DL_DIR = "${TOPDIR}/downloads"
SSTATE_DIR = "${TOPDIR}/sstate-cache"
TMPDIR = "${TOPDIR}/tmp"

DISTRO = "poky-jukebox"
MACHINE = "raspberrypi0-2w-64"

INHERIT += "rm_work"
RM_WORK_EXCLUDE += "jukebox-image"

# RFID_JUKEBOX_NETWORK_ADDRESS = "xxx.xxx.xxx.xxx/xx"
# RFID_JUKEBOX_NETWORK_GATEWAY = "xxx.xxx.xxx.xxx"
# RFID_JUKEBOX_SSID = ""    
# RFID_JUKEBOX_PSK = ""

# PACKAGE_FEED_URIS = ""
# PACKAGE_FEED_BASE_PATHS = ""

# RFID_JUKEBOX_MP3_FOLDER = ""
```
